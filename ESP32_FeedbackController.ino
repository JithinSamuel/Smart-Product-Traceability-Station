#include <WiFi.h>
#include <WebServer.h>
#include <ArduinoJson.h>
#include <Wire.h>
#include <Adafruit_GFX.h>
#include <Adafruit_SSD1306.h>
#include <LiquidCrystal_I2C.h>
#include <ESP32Servo.h>

// OLED setup
#define SCREEN_WIDTH 128
#define SCREEN_HEIGHT 64
#define OLED_RESET -1
Adafruit_SSD1306 oled(SCREEN_WIDTH, SCREEN_HEIGHT, &Wire, OLED_RESET);

// LCD setup
LiquidCrystal_I2C lcd(0x27, 16, 2); 

// Pins
#define BUZZER_PIN 13
#define SERVO_PIN 14
#define RED_PIN 4
#define GREEN_PIN 5
#define BLUE_PIN 2

Servo myServo;

WiFi credentials
const char* ssid = "";
const char* password = ""; 

WebServer server(80);

// Intel Logo Bitmap

#define INTEL_LOGO_WIDTH 128
#define INTEL_LOGO_HEIGHT 64
const unsigned char intel_logo_bmp [] PROGMEM = {

    0x00, 0x00, 0x00, 0x00, 0x00, 0x00, 0x00, 0x00, 0x00, 0x00, 0x00, 0x00, 0x00, 0x00, 0x00, 0x00, 
  0x00, 0x00, 0x00, 0x00, 0x00, 0x00, 0x00, 0x00, 0x00, 0x00, 0x00, 0x00, 0x00, 0x00, 0x00, 0x00, 
  0x00, 0x00, 0x00, 0x00, 0x00, 0x00, 0x00, 0x00, 0x00, 0x00, 0x00, 0x00, 0x00, 0x00, 0x00, 0x00, 
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  0x00, 0x00, 0x00, 0x00, 0x00, 0x00, 0x00, 0x00, 0x00, 0x00, 0x00, 0x00, 0x00, 0x00, 0x00, 0x00
};

// Function declarations
void handleControlRequest();
void handleMatch(const JsonObject& details, const char* device_id);
void handleReject(const JsonObject& details, const char* device_id);
void displayOledDetails(const JsonObject& details, const char* device_id);
void resetDisplays();
void showProgressBar();

void setup() {
  Serial.begin(115200);
  delay(1000);

  // Initialize OLED
  if (!oled.begin(SSD1306_SWITCHCAPVCC, 0x3C)) { 
    Serial.println(F("OLED not found. Halting."));
    while (true); 
  }

  oled.clearDisplay();
  // Draw Intel logo centered
  oled.drawBitmap((oled.width() - INTEL_LOGO_WIDTH) / 2,
                  (oled.height() - INTEL_LOGO_HEIGHT) / 2,
                  intel_logo_bmp, INTEL_LOGO_WIDTH, INTEL_LOGO_HEIGHT, 1);
  oled.display();
  delay(3000); 

  showProgressBar();

  // Initialize LCD
  lcd.begin(16, 2);
  lcd.backlight();
  lcd.setCursor(0, 0);
  lcd.print("System Ready");
  lcd.setCursor(0, 1);
  lcd.print("Init...");

  // Setup pins
  pinMode(BUZZER_PIN, OUTPUT);
  pinMode(RED_PIN, OUTPUT);
  pinMode(GREEN_PIN, OUTPUT);
  pinMode(BLUE_PIN, OUTPUT);
  digitalWrite(BUZZER_PIN, LOW);
  digitalWrite(RED_PIN, LOW);
  digitalWrite(GREEN_PIN, LOW);
  digitalWrite(BLUE_PIN, LOW);

  // Setup servo
  myServo.setPeriodHertz(50);
  myServo.attach(SERVO_PIN, 500, 2500);
  myServo.write(90);

  // WiFi Connection
  Serial.print("Connecting to WiFi: ");
  Serial.println(ssid);
  WiFi.begin(ssid, password);
  while (WiFi.status() != WL_CONNECTED) {
    delay(500);
    Serial.print(".");
    lcd.setCursor(0, 1);
    lcd.print("Connecting WiFi...");
  }

  Serial.println("\nWiFi connected.");
  Serial.print("IP Address: ");
  Serial.println(WiFi.localIP());

  // Update LCD with IP
  lcd.clear();
  lcd.setCursor(0, 0);
  lcd.print("System Ready");
  lcd.setCursor(0, 1);
  lcd.print("IP: ");
  lcd.print(WiFi.localIP());

  // Setup web server
  server.on("/control", HTTP_POST, handleControlRequest);
  server.begin();
  Serial.println("HTTP server started.");
}

void loop() {
  server.handleClient();
}

void handleControlRequest() {
  if (!server.hasArg("plain")) {
    server.send(400, "text/plain", "Body not received.");
    return;
  }

  String body = server.arg("plain");
  StaticJsonDocument<1024> doc;

  // Print raw JSON to Serial for debugging
  Serial.print("Received JSON: ");
  Serial.println(body);

  DeserializationError error = deserializeJson(doc, body);

  if (error) {
    server.send(400, "text/plain", "Invalid JSON. Error: " + String(error.c_str()));
    Serial.print("JSON parsing failed: ");
    Serial.println(error.c_str());
    return;
  }

  const char* status_cstr = doc["status"];
  const char* device_id_cstr = doc["device_id"];
  JsonObject details = doc["details"].as<JsonObject>();

  if (!status_cstr || !device_id_cstr || details.isNull()) {
    server.send(400, "text/plain", "Missing fields (status, device_id, or details).");
    Serial.println("Missing JSON fields.");
    return;
  }

  if (strcmp(status_cstr, "accepted") == 0) {
    handleMatch(details, device_id_cstr);
  } else if (strcmp(status_cstr, "rejected") == 0) {
    handleReject(details, device_id_cstr);
  } else {
    server.send(400, "text/plain", "Unknown status value: " + String(status_cstr));
    Serial.print("Unknown status: ");
    Serial.println(status_cstr);
    return;
  }

  server.send(200, "text/plain", "OK");
}

void handleMatch(const JsonObject& details, const char* device_id) {
  digitalWrite(GREEN_PIN, HIGH);
  digitalWrite(RED_PIN, LOW);
  digitalWrite(BLUE_PIN, LOW);

  // Buzzer tones for accepted
  tone(BUZZER_PIN, 1000, 300);
  delay(300);
  noTone(BUZZER_PIN);
  tone(BUZZER_PIN, 1500, 300);
  delay(300);
  noTone(BUZZER_PIN);

  // Servo movement for accepted
  myServo.write(45);
  delay(1000);       
  myServo.write(90);  
  delay(500);        

  lcd.clear();
  lcd.setCursor(0, 0);
  lcd.print("RoHS: Compliant");
  lcd.setCursor(0, 1);
  lcd.print("Status: Accepted");

  oled.clearDisplay();
  oled.setTextSize(1);
  oled.setTextColor(SSD1306_WHITE);
  oled.setCursor(0, 0);
  oled.println("MATCHED DEVICE");
  displayOledDetails(details, device_id);

  delay(3000);
  resetDisplays(); 
}

void handleReject(const JsonObject& details, const char* device_id) {
  digitalWrite(RED_PIN, HIGH);
  digitalWrite(GREEN_PIN, LOW);
  digitalWrite(BLUE_PIN, LOW);

  // Buzzer tones for rejected
  tone(BUZZER_PIN, 300, 400);
  delay(400);
  noTone(BUZZER_PIN);
  tone(BUZZER_PIN, 200, 300);
  delay(300);
  noTone(BUZZER_PIN);

  // Servo movement for rejected 
  myServo.write(135); 
  delay(1000);
  myServo.write(90); 
  delay(500);    

  lcd.clear();
  lcd.setCursor(0, 0);
  lcd.print("RoHS: Not Compl.");
  lcd.setCursor(0, 1);
  lcd.print("Status: Rejected");

  oled.clearDisplay();
  oled.setTextSize(1);
  oled.setTextColor(SSD1306_WHITE);
  oled.setCursor(0, 0);
  oled.println("REJECTED DEVICE");
  displayOledDetails(details, device_id);

  delay(3000);
  resetDisplays();

void displayOledDetails(const JsonObject& details, const char* device_id) {
  int y = 12;

  // Display Device ID from the top-level JSON field
  oled.setCursor(0, y);
  oled.print("Dev ID: ");
  oled.println(device_id);
  y += 10;

  // Extract and display specific details from the 'details' JsonObject
  if (details.containsKey("BatchId")) {
    oled.setCursor(0, y);
    oled.print("Batch ID: ");
    oled.println(details["BatchId"].as<const char*>());
    y += 10;
  }
  if (details.containsKey("FactoryId")) {
    oled.setCursor(0, y);
    oled.print("Factory ID: ");
    oled.println(details["FactoryId"].as<const char*>());
    y += 10;
  }
  if (details.containsKey("FactoryLocation")) {
    oled.setCursor(0, y);
    oled.print("Location: ");
    oled.println(details["FactoryLocation"].as<const char*>());
    y += 10;
  }
  if (details.containsKey("Shift")) {
    oled.setCursor(0, y);
    oled.print("Shift: ");
    oled.println(details["Shift"].as<const char*>());
    y += 10;
  }
  //Check for RoHS status 
  if (details.containsKey("RoHS")) {
    oled.setCursor(0, y);
    oled.print("RoHS: ");
    oled.println(details["RoHS"].as<const char*>());
    y += 10;
  }
 
  oled.display();
}

void showProgressBar() {
  oled.clearDisplay();
  oled.setTextSize(1);
  oled.setTextColor(SSD1306_WHITE);
  oled.setCursor(0, 0);
  oled.println("Smart Product");
  oled.setCursor(0, 10);
  oled.println("Traceability");
  oled.setCursor(0, 20);
  oled.println("Station");
  oled.setCursor(0, 40);
  oled.println("Scan QR Code...");
  oled.display();
  
  // Progress bar animation
  for (int i = 0; i <= 128; i += 8) { 
    oled.fillRect(0, 55, i, 5, SSD1306_WHITE); 
    oled.display();
    delay(50); 
  }
  delay(500); 
}

void resetDisplays() {
  lcd.clear();
  lcd.setCursor(0, 0);
  lcd.print("System Ready");
  lcd.setCursor(0, 1);
  lcd.print("Scan QR Code...");

  oled.clearDisplay();
  oled.setTextSize(1);
  oled.setTextColor(SSD1306_WHITE);
  oled.setCursor(0, 0);
  oled.println("Smart Product");
  oled.setCursor(0, 10);
  oled.println("Traceability");
  oled.setCursor(0, 20);
  oled.println("Station");
  oled.setCursor(0, 40);
  oled.println("Scan QR Code...");
  oled.display();

  // Turn off RGB LEDs
  digitalWrite(RED_PIN, LOW);
  digitalWrite(GREEN_PIN, LOW);
  digitalWrite(BLUE_PIN, LOW);
}
